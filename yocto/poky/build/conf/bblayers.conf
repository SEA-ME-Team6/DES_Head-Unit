## yocto/poky/build/conf/bblayers.conf
```bitbake
# POKY_BBLAYERS_CONF_VERSION is increased each time build/conf/bblayers.conf
# changes incompatibly
POKY_BBLAYERS_CONF_VERSION = "2"

BBPATH = "${TOPDIR}"
BBFILES ?= ""

BBLAYERS ?= " \
  /home/seame-workstation09/SEAME/DES_Head-Unit/yocto/poky/meta \
  /home/seame-workstation09/SEAME/DES_Head-Unit/yocto/poky/meta-poky \
  /home/seame-workstation09/SEAME/DES_Head-Unit/yocto/poky/meta-yocto-bsp \
  /home/seame-workstation09/SEAME/DES_Head-Unit/yocto/poky/meta-openembedded/meta-oe \
  /home/seame-workstation09/SEAME/DES_Head-Unit/yocto/poky/meta-openembedded/meta-python \
  /home/seame-workstation09/SEAME/DES_Head-Unit/yocto/poky/meta-openembedded/meta-networking \
  /home/seame-workstation09/SEAME/DES_Head-Unit/yocto/poky/meta-qt5 \
  /home/seame-workstation09/SEAME/DES_Head-Unit/yocto/poky/meta-splash \
  /home/seame-workstation09/SEAME/DES_Head-Unit/yocto/poky/meta-jaden \
  /home/seame-workstation09/SEAME/DES_Head-Unit/yocto/poky/meta-ivi \
  /home/seame-workstation09/SEAME/DES_Head-Unit/yocto/poky/meta-raspberrypi \
  "
```
